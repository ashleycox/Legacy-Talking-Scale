/**
  Arduino Talking Scale
  A simple scale using the HX711, a 328-based arduino and the Talkie text to speech library.
  Concept and code by Ashley Cox, with libraries the property of their respective owners and distributed in accordance with their respective licenses
  More details on this project at https://www.ashleycox.co.uk
**/

#include <EEPROMex.h>
#include <EEPROMVar.h>
#include <talkie.h>
#include "HX711.h"

//Program variables
const int LOADCELL_DOUT_PIN = 4; //HX711 digital out
const int LOADCELL_SCK_PIN = 5; //HX711 CLK
int r1; //Number before decimal
int r2; //The first decimal
int r3; //the second decimal
float cal_factor; //Scale calibration factor, set by calibration function
float reading; //Scale Measurement
const int buttonPin = 2; //Calibration button pin
int calPressed = 0; //is the button pressed
int calibrated = 1; //used for the innitial tare on power up

//Speech variables
const uint8_t spGRAMS[] PROGMEM = {};
const uint8_t spZERO[] PROGMEM = {0x69, 0xFB, 0x59, 0xDD, 0x51, 0xD5, 0xD7, 0xB5, 0x6F, 0x0A, 0x78, 0xC0, 0x52,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 0xFF, 0x1F};
const uint8_t spONE[] PROGMEM = {0x66, 0x4E, 0xA8, 0x7A, 0x8D, 0xED, 0xC4, 0xB5, 0xCD, 0x89, 0xD4, 0xBC, 0xA2,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 0xFE, 0x1F};
const uint8_t spTWO[]  PROGMEM = {0x06, 0xB8, 0x59, 0x34, 0x00, 0x27, 0xD6, 0x38, 0x60, 0x58, 0xD3, 0x91, 0x55,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 0xFF, 0x1F};
const uint8_t spTHREE[] PROGMEM = {0x0C, 0xE8, 0x2E, 0x94, 0x01, 0x4D, 0xBA, 0x4A, 0x40, 0x03, 0x16, 0x68, 0x69,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 0xFF, 0x03};
const uint8_t spFOUR[] PROGMEM = {0x08, 0x68, 0x21, 0x0D, 0x03, 0x1C, 0x90, 0xC0, 0x88, 0x92, 0xB2, 0x29, 0x87,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 0xFC, 0x3F};
const uint8_t spFIVE[] PROGMEM = {0x08, 0x68, 0x4E, 0x9D, 0x02, 0x1C, 0x60, 0xC0, 0x8C, 0x69, 0x12, 0xB0, 0xC0,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 0xFF, 0x01};
const uint8_t spSIX[] PROGMEM = {0x04, 0xF8, 0xB9, 0x55, 0x01, 0xBF, 0xA5, 0x1B, 0xE0, 0x37, 0x0F, 0x03, 0xFC,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 0xFC, 0x3F};
const uint8_t spSEVEN[] PROGMEM = {0x0C, 0x78, 0xC6, 0x95, 0x01, 0x3F, 0xA5, 0x28, 0xE0, 0xB7, 0x52, 0x0B, 0x04,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 0xFF, 0x07};
const uint8_t spEIGHT[] PROGMEM = {0xAD, 0x1B, 0xDE, 0x58, 0x23, 0x17, 0xAF, 0x6E, 0xE8, 0x20, 0xEB, 0x5C, 0xBC,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 0xFF, 0x0F};
const uint8_t spNINE[] PROGMEM = {0x62, 0x75, 0xDC, 0x33, 0xB5, 0x62, 0xB9, 0x25, 0x0B, 0x8E, 0x34, 0x8F, 0xD3,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 0xFF, 0x03};
const uint8_t spPOINT[] PROGMEM = {0x0A, 0xC8, 0x2E, 0x8C, 0x01, 0xD1, 0x85, 0x95, 0x34, 0x8B, 0xAA, 0x74, 0x56,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 0xFB, 0x7F};
const uint8_t spSTART[] PROGMEM = {0x02, 0xF8, 0x49, 0xCC, 0x00, 0xBF, 0x87, 0x3B, 0xE0, 0xB7, 0x60, 0x03, 0xFC,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 0xFE, 0x1F};
const uint8_t spREADY[] PROGMEM = {0x6A, 0xB4, 0xD9, 0x25, 0x4A, 0xE5, 0xDB, 0xD9, 0x8D, 0xB1, 0xB2, 0x45, 0x9A,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 0x7F,};
const uint8_t spERROR[] PROGMEM = {0x6D, 0x6C, 0x6E, 0x89, 0x5B, 0x36, 0x8F, 0xA9, 0x9B, 0x11, 0x5A, 0xE9, 0x33,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 0xFF, 0x3F};

//Initialise libraries
Talkie voice;
HX711 scale;

void setup() {
  
  //Initialise calibration button with onboard pullup resistor
  pinMode(buttonPin, INPUT_PULLUP);

  //initalise the HX711
  scale.begin(LOADCELL_DOUT_PIN, LOADCELL_SCK_PIN);
if(EEPROM.readFloat(0)) {
cal_factor = EEPROM.readFloat(0);
scale.set_scale(cal_factor);
} else {
scale.set_scale(0);
}
        voice.say(spREADY);
}

void loop() {
  //detects when the calibration button is held
  while (digitalRead(buttonPin) == LOW ) {
    calPressed = 1;
  }
  if (calPressed == 0) {
    measurement();
  }
  else if (calPressed == 1) {
    //reset so we don't run calibration indefinitely
    calPressed = 0;
    calibration();
  }
}

void measurement() {
    //We don't want to tare if we just calibrated
    if(calibrated == 1) {
      calibrated = 0;
      scale.tare();
    }
    //Take an average of 20 readings from the HX711 for better accuracy
  reading = scale.get_units(20), 2;
  //We break the reading up to speak it properly
  //R1 is an integer, therefore we lose the decimal
  r1 = reading;
  //Work out the decimal
  r2 = reading * 10 - r1 * 10;
  //A second decimal
  r3 = reading / r1;
  //Speak the reading
  speakNum(r1);
  voice.say(spPOINT);
  speakNum(r2);
  speakNum(r3);
  //Put the HX711 in sleep mode
  scale.power_down();
  //add a second between the spoken values
  delay(1000);
  //Power up the HX711
  scale.power_up();
}

void calibration () {
  //Zero the scale
  scale.set_scale();
  scale.tare();
  voice.say(spSTART);
  //gives us time to place the weight
  delay (2000);
  //Populate our calibration factor variable
//using a 5 gram known weight
cal_factor = scale.get_units(20) / 5.00;
  scale.set_scale(cal_factor);
if(EEPROM.readFloat(0)) {
  EEPROM.updateFloat(0, cal_factor);
} else {
  EEPROM.writeFloat(0, cal_factor);
}
    delay(100);
  voice.say(spFIVE);
  calibrated = 0;
  measurement();
}

//simple function to translate the numbers 1-9 and 0 into spoken values
void speakNum(int x) {
  if (x == 1) {
    voice.say(spONE);
  } else if (x == 2) {
    voice.say(spTWO);
  } else if (x == 3) {
    voice.say(spTHREE);
  } else if (x == 4) {
    voice.say(spFOUR);
  } else if (x == 5) {
    voice.say (spFIVE);
  } else if (x == 6) {
    voice.say(spSIX);
  } else if (x == 7) {
    voice.say(spSEVEN);
  } else if (x == 8) {
    voice.say(spEIGHT);
  } else if (x == 9) {
    voice.say(spNINE);
  } else if (x == 0) {
    voice.say(spZERO);
  } else {
    voice.say(spERROR);
  }
}
